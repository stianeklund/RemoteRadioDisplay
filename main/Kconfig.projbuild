## main/Kconfig.projbuild
```kconfig
menu "Remote Radio Display"

    menu "WiFi Configuration"

        config ESP_WIFI_SSID
            string "WiFi SSID"
            default "myssid"
            help
                SSID of the Wi-Fi network to connect to.

        config ESP_WIFI_PASSWORD
            string "WiFi Password"
            default "mypassword"
            help
                Password of the Wi-Fi network.

        config ESP_MAXIMUM_RETRY
            int "Maximum Connect Retries"
            default 5
            range 1 20
            help
                Maximum number of times to retry connecting to Wi-Fi before giving up.

    endmenu

    menu "Antenna Controller"
        
        config ANTENNA_SERVER_HOSTNAME
            string "Antenna Controller Hostname"
            default "antenna-controller.local"
            help
                Hostname or IP address of the antenna controller WebSocket server.
                Examples: "192.168.1.100" or "antenna-controller.local"

        config ANTENNA_SERVER_PORT
            int "Antenna Controller Port"
            default 80
            range 1 65535
            help
                Port number of the antenna controller WebSocket server.

        config ANTENNA_WS_URI
            string "WebSocket URI Path"
            default "/ws"
            help
                URI path for the WebSocket endpoint on the antenna controller.

        config ANTENNA_RECONNECT_INTERVAL
            int "Reconnection Interval (seconds)"
            default 5
            range 1 60
            help
                Interval between WebSocket reconnection attempts when disconnected.

        config ANTENNA_ENABLE_MDNS_LOOKUP
            bool "Enable mDNS hostname resolution"
            default y
            help
                Enable mDNS to resolve .local hostnames to IP addresses.
                Required if using hostname instead of IP address.

        config ANTENNA_CONNECTION_TIMEOUT
            int "Connection Timeout (seconds)" 
            default 10
            range 5 60
            help
                Timeout for WebSocket connection establishment.

        config ANTENNA_APP_HEARTBEAT_ENABLE
            bool "Enable application heartbeat over WebSocket"
            default n
            help
                When enabled, periodically sends a lightweight request (status)
                as an application-layer heartbeat to keep the server-side
                activity counter alive and detect dead connections. This is
                complementary to WebSocket ping/pong and TCP keepalive.

        config ANTENNA_APP_HEARTBEAT_INTERVAL
            int "Application heartbeat interval (seconds)"
            depends on ANTENNA_APP_HEARTBEAT_ENABLE
            default 90
            range 10 600
            help
                Interval between application-level heartbeat messages.
                Recommended 60–120 seconds for typical WiFi/NAT environments.

    endmenu

    menu "CAT Interface (TS-590SG)"

        choice CAT_UART_PORT
            prompt "UART Port"
            default CAT_UART_PORT_UART1
            help
                Select which UART peripheral to use for CAT communication with the TS-590SG.
            config CAT_UART_PORT_UART0
                bool "UART0"
            config CAT_UART_PORT_UART1
                bool "UART1"
            config CAT_UART_PORT_UART2
                bool "UART2"
        endchoice

        config CAT_UART_BAUD
            int "Baud Rate"
            default 57600
            range 4800 115200
            help
                Baud rate for CAT serial communication.
                Must match the TS-590SG Menu 67 (COM port baud rate) setting.
                Common values: 4800, 9600, 19200, 38400, 57600, 115200

        config CAT_UART_TX_PIN
            int "TX GPIO Pin"
            default 17
            range 0 48
            help
                GPIO pin for UART TX (ESP32 transmit to radio).

        config CAT_UART_RX_PIN
            int "RX GPIO Pin"
            default 18
            range 0 48
            help
                GPIO pin for UART RX (ESP32 receive from radio).

    endmenu

endmenu
```

## sdkconfig.defaults
```kconfig
# Common configuration for all targets
# Target-specific settings go in sdkconfig.defaults.esp32s3 / sdkconfig.defaults.esp32p4

CONFIG_BOOTLOADER_COMPILER_OPTIMIZATION_PERF=y
CONFIG_ESPTOOLPY_FLASHMODE_QIO=y
CONFIG_ESPTOOLPY_FLASHSIZE_16MB=y
CONFIG_PARTITION_TABLE_CUSTOM=y

# Common SPIRAM settings
CONFIG_SPIRAM=y
CONFIG_SPIRAM_MEMTEST=n
CONFIG_SPIRAM_ALLOW_STACK_EXTERNAL_MEMORY=y
CONFIG_SPIRAM_ALLOW_BSS_SEG_EXTERNAL_MEMORY=n

# FreeRTOS Configuration
CONFIG_FREERTOS_HZ=1000
CONFIG_FREERTOS_GENERATE_RUN_TIME_STATS=y
CONFIG_FREERTOS_USE_TRACE_FACILITY=y
CONFIG_FREERTOS_USE_STATS_FORMATTING_FUNCTIONS=y
CONFIG_FREERTOS_TIMER_TASK_STACK_DEPTH=1536

# MDNS
CONFIG_MDNS_TASK_STACK_SIZE=3072

# LVGL 9 Configuration
CONFIG_LV_USE_CLIB_MALLOC=y
CONFIG_LV_USE_CLIB_SPRINTF=y
CONFIG_LV_USE_CLIB_STRING=y
CONFIG_LV_USE_PERF_MONITOR=y
CONFIG_LV_COLOR_DEPTH_16=y
CONFIG_LV_FONT_MONTSERRAT_14=y
CONFIG_LV_FONT_MONTSERRAT_24=y
CONFIG_LV_FONT_MONTSERRAT_36=y

# LWIP TCP/IP tuning
CONFIG_LWIP_TCP_MSL=5000
CONFIG_LWIP_TCP_FIN_WAIT_TIMEOUT=5000
CONFIG_LWIP_TCP_MAXRTX=6
CONFIG_LWIP_TCP_SYNMAXRTX=3
CONFIG_LWIP_UDP_RECVMBOX_SIZE=4
CONFIG_LWIP_TCPIP_RECVMBOX_SIZE=8
CONFIG_LWIP_MEM_ALIGNMENT=4
CONFIG_LWIP_TCP_MSS=1436
CONFIG_LWIP_RECV_BUFSIZE_DEFAULT=1436
CONFIG_LWIP_TCP_SND_BUF_DEFAULT=1460
CONFIG_LWIP_TCP_WND_DEFAULT=1460

# Pin LWIP to Core 0
CONFIG_LWIP_TCPIP_TASK_AFFINITY_CPU0=y
CONFIG_LWIP_TCPIP_TASK_AFFINITY=0x1

# Compiler optimization
CONFIG_COMPILER_OPTIMIZATION_SIZE=y

# Watchdog Configuration
CONFIG_ESP_INT_WDT_TIMEOUT_MS=2000
CONFIG_ESP_TASK_WDT_EN=y
CONFIG_ESP_TASK_WDT_INIT=y
CONFIG_ESP_TASK_WDT_TIMEOUT_S=10
CONFIG_ESP_TASK_WDT_CHECK_IDLE_TASK_CPU0=y
CONFIG_ESP_TASK_WDT_CHECK_IDLE_TASK_CPU1=y
```

## sdkconfig.defaults.esp32p4
```kconfig
# ESP32-P4 specific configuration (Guition JC-ESP32P4-M3 + 5" DSI 720x1280)

CONFIG_IDF_TARGET="esp32p4"

# CPU frequency: 360MHz (P4 max)
CONFIG_ESP_DEFAULT_CPU_FREQ_MHZ_360=y

# SPIRAM: 32MB PSRAM on Guition board
CONFIG_SPIRAM_MODE_QUAD=y
CONFIG_SPIRAM_SPEED_200M=y
CONFIG_SPIRAM_TRY_ALLOCATE_WIFI_LWIP=y
CONFIG_SPIRAM_MALLOC_ALWAYSINTERNAL=16384
CONFIG_SPIRAM_MALLOC_RESERVE_INTERNAL=32768

# MIPI DSI PHY power: LDO channel 3 at 2500mV
CONFIG_ESP_LCD_MIPI_DSI_LDO_CHAN=3
CONFIG_ESP_LCD_MIPI_DSI_LDO_VOLTAGE_MV=2500

# WiFi Remote via ESP32-C6 coprocessor (SDIO transport)
CONFIG_ESP_WIFI_REMOTE_ENABLED=y
CONFIG_SLAVE_IDF_TARGET_ESP32C6=y
CONFIG_ESP_SDIO_PIN_SLOT1=y

# P4 bootloader is larger than S3 - use size optimization to fit
CONFIG_BOOTLOADER_COMPILER_OPTIMIZATION_SIZE=y

# I2C ISR IRAM-safe
CONFIG_I2C_ISR_IRAM_SAFE=y

# CAT UART: GPIO1 (TX) / GPIO2 (RX) on Guition Expand IO header (JP1 pins 7/9)
CONFIG_CAT_UART_TX_PIN=1
CONFIG_CAT_UART_RX_PIN=2
```

## sdkconfig.defaults.esp32s3
```kconfig
# ESP32-S3 specific configuration (Sunton ESP32-8048S050C)

CONFIG_IDF_TARGET="esp32s3"

# SPIRAM: OctalSPI mode
CONFIG_SPIRAM_MODE_OCT=y
CONFIG_SPIRAM_FETCH_INSTRUCTIONS=y
CONFIG_SPIRAM_RODATA=y
CONFIG_SPIRAM_SPEED_80M=y
CONFIG_SPIRAM_TRY_ALLOCATE_WIFI_LWIP=y

# SPIRAM allocation thresholds
CONFIG_SPIRAM_MALLOC_ALWAYSINTERNAL=4096
CONFIG_SPIRAM_MALLOC_RESERVE_INTERNAL=8192

# CPU and Cache
CONFIG_ESP_DEFAULT_CPU_FREQ_MHZ_240=y
CONFIG_ESP32S3_DATA_CACHE_64KB=y

# WiFi memory optimizations (reduced for SRAM conservation on S3)
CONFIG_ESP32_WIFI_STATIC_RX_BUFFER_NUM=2
CONFIG_ESP32_WIFI_DYNAMIC_RX_BUFFER_NUM=4
CONFIG_ESP32_WIFI_STATIC_TX_BUFFER_NUM=2
CONFIG_ESP32_WIFI_DYNAMIC_TX_BUFFER_NUM=4
CONFIG_ESP32_WIFI_AMPDU_TX_ENABLED=n
CONFIG_ESP32_WIFI_AMPDU_RX_ENABLED=n
CONFIG_ESP32_WIFI_AMSDU_TX_ENABLED=n

# RGB LCD configuration
CONFIG_LCD_RGB_RESTART_IN_VSYNC=n
CONFIG_LCD_RGB_ISR_IRAM_SAFE=y
CONFIG_GDMA_ISR_IRAM_SAFE=y

# PSRAM XIP - Critical for RGB LCD stability
CONFIG_SPIRAM_XIP_FROM_PSRAM=y

# I2C ISR IRAM-safe for flash cache disabled scenarios
CONFIG_I2C_ISR_IRAM_SAFE=y

# LVGL Port: use PPA for rotation
CONFIG_LVGL_PORT_ENABLE_PPA=y
```
